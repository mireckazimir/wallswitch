## software/main/Kconfig.projbuild
```kconfig
menu "Configuration"
    config ESP_WIFI_SSID
        string "WiFi SSID"
        default "myssid"
        help
            SSID (network name) for the example to connect to.

    config ESP_WIFI_PASSWORD
        string "WiFi Password"
        default "mypassword"
        help
            WiFi password (WPA or WPA2) for the example to use.

    config ESP_MAXIMUM_RETRY
        int "Maximum retry"
        default 5
        help
            Set the Maximum retry to avoid station reconnecting to the AP unlimited when the AP is really inexistent.
    
    config BROKER_URL
        string "Broker URL"
        default "mqtt://mqtt.eclipseprojects.io"
        help
            URL of the broker to connect to

    config BROKER_URL_FROM_STDIN
        bool
        default y if BROKER_URL = "FROM_STDIN"

    config I2C_MASTER_SCL
        int "SCL GPIO Num"
        default 6 if IDF_TARGET_ESP32C3 || IDF_TARGET_ESP32C2 || IDF_TARGET_ESP32H2
        default 19 if IDF_TARGET_ESP32 || IDF_TARGET_ESP32S2 || IDF_TARGET_ESP32S3
        help
            GPIO number for I2C Master clock line.

    config I2C_MASTER_SDA
        int "SDA GPIO Num"
        default 5 if IDF_TARGET_ESP32C3 || IDF_TARGET_ESP32C2 || IDF_TARGET_ESP32H2
        default 18 if IDF_TARGET_ESP32 || IDF_TARGET_ESP32S2 || IDF_TARGET_ESP32S3
        help
            GPIO number for I2C Master data line.
    
    config ESP32_BUTTON_LONG_PRESS_DURATION_MS
        int "Button long press duration in ms"
        default 2000
        help
            Defines how long a button has to be pressed to trigger BUTTON_HELD events.
    
    config ESP32_BUTTON_LONG_PRESS_REPEAT_MS
        int "Button long press repetition in ms"
        default 50
        help
            Defines in which interval BUTTON_HELD events are generated while a button is long pressed.
    
    config ESP32_BUTTON_QUEUE_SIZE
        int "Size of the button event queue"
        default 4
        help
            Defines how many button events the queue can store. If the queue is full because the events
            are not retreived from the queue quickly enough, the button task has to wait and does not
            process any button presses during this time.
    
    config ESP32_BUTTON_TASK_STACK_SIZE
        int "Button update task stack size"
        default 3072
        help
            Configure the stack size of the button task in bytes. Reducing this value to 2048 should not
            cause any problems.
endmenu
```
